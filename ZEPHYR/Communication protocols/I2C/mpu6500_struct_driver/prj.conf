## CMakeLists.txt
```
cmake_minimum_required(VERSION 3.20.0)

find_package(Zephyr REQUIRED HINTS $ENV{ZEPHYR_BASE})

project(mpu6500_struct_driver)

target_sources(app PRIVATE
    src/main.c
    src/mpu6500.c
)
```

## prj.conf
```kconfig
CONFIG_I2C=y
CONFIG_SERIAL=y
CONFIG_CONSOLE=y
```

## src/main.c
```c
#include <zephyr/kernel.h>
#include <zephyr/sys/printk.h>

#include "mpu6500.h"

int main(void)
{
    struct imu_data imu;

    if (mpu6500_init())
    {
        printk("MPU6500 Init Failed\n");
        return 0;
    }

    printk("MPU6500 Driver Started\n");

    while (1)
    {
        if (!mpu6500_read_all(&imu))
        {
            printk(
                "AX:%6d AY:%6d AZ:%6d | "
                "GX:%6d GY:%6d GZ:%6d\n",
                imu.ax,
                imu.ay,
                imu.az,
                imu.gx,
                imu.gy,
                imu.gz);
        }

        k_sleep(K_MSEC(500));
    }

    return 0;
}
```

## src/mpu6500.c
```c
#include "mpu6500.h"

#include <zephyr/device.h>
#include <zephyr/drivers/i2c.h>

#define I2C_NODE DT_NODELABEL(i2c1)

#define MPU6500_ADDR 0x68
#define ACCEL_XOUT_H 0x3B

static const struct device *i2c_dev;

int mpu6500_init(void)
{
    i2c_dev = DEVICE_DT_GET(I2C_NODE);

    if (!device_is_ready(i2c_dev))
    {
        return -1;
    }

    return 0;
}

int mpu6500_read_all(struct imu_data *imu)
{
    uint8_t reg = ACCEL_XOUT_H;

    uint8_t data[14];

    int ret;

    ret = i2c_write_read(
            i2c_dev,
            MPU6500_ADDR,
            &reg,
            1,
            data,
            14);

    if (ret)
    {
        return ret;
    }

    imu->ax = (int16_t)((data[0] << 8) | data[1]);
    imu->ay = (int16_t)((data[2] << 8) | data[3]);
    imu->az = (int16_t)((data[4] << 8) | data[5]);

    imu->gx = (int16_t)((data[8] << 8) | data[9]);
    imu->gy = (int16_t)((data[10] << 8) | data[11]);
    imu->gz = (int16_t)((data[12] << 8) | data[13]);

    return 0;
}
```

## src/mpu6500.h
```c
#ifndef MPU6500_H
#define MPU6500_H

#include <stdint.h>

struct imu_data
{
    int16_t ax;
    int16_t ay;
    int16_t az;

    int16_t gx;
    int16_t gy;
    int16_t gz;
};

int mpu6500_init(void);

int mpu6500_read_all(
    struct imu_data *imu);

#endif
```
