## CMakeLists.txt
```
cmake_minimum_required(VERSION 3.20.0)

find_package(Zephyr REQUIRED HINTS $ENV{ZEPHYR_BASE})

project(uart_mutex)

target_sources(app PRIVATE src/main.c)
```

## prj.conf
```kconfig
CONFIG_SERIAL=y
CONFIG_UART_CONSOLE=y
CONFIG_PRINTK=y
```

## src/main.c
```c
#include <zephyr/kernel.h>
#include <zephyr/device.h>
#include <zephyr/drivers/uart.h>

#define STACK_SIZE 1024

const struct device *uart_dev;

struct k_mutex uart_mutex;

K_THREAD_STACK_DEFINE(stack_a, STACK_SIZE);
K_THREAD_STACK_DEFINE(stack_b, STACK_SIZE);

struct k_thread thread_a;
struct k_thread thread_b;

void uart_task_a(void *p1, void *p2, void *p3)
{
    while (1)
    {
        const char msg[] =
        "AAAAAAAAAAAAAAAAAAAAAAAAAAAAAA\r\n";

        k_mutex_lock(&uart_mutex, K_FOREVER);

        for (int i = 0; msg[i] != '\0'; i++)
        {
            uart_poll_out(uart_dev, msg[i]);

            k_yield();
        }

        k_mutex_unlock(&uart_mutex);

        k_msleep(1000);
    }
}

void uart_task_b(void *p1, void *p2, void *p3)
{
    while (1)
    {
        const char msg[] =
        "BBBBBBBBBBBBBBBBBBBBBBBBBBBBBB\r\n";

        k_mutex_lock(&uart_mutex, K_FOREVER);

        for (int i = 0; msg[i] != '\0'; i++)
        {
            uart_poll_out(uart_dev, msg[i]);

            k_yield();
        }

        k_mutex_unlock(&uart_mutex);

        k_msleep(1000);
    }
}

int main(void)
{
    uart_dev = DEVICE_DT_GET(DT_CHOSEN(zephyr_console));

    if (!device_is_ready(uart_dev))
    {
        return 0;
    }

    k_mutex_init(&uart_mutex);

    k_thread_create(&thread_a,
                    stack_a,
                    STACK_SIZE,
                    uart_task_a,
                    NULL, NULL, NULL,
                    5, 0, K_NO_WAIT);

    k_thread_create(&thread_b,
                    stack_b,
                    STACK_SIZE,
                    uart_task_b,
                    NULL, NULL, NULL,
                    5, 0, K_NO_WAIT);

    while (1)
    {
        k_msleep(10000);
    }
}
```
