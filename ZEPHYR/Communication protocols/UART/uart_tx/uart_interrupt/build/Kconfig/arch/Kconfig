## ZEPHYR/Communication protocols/UART/uart_tx/uart_interrupt/build/Kconfig/arch/Kconfig
```kconfig
# Load Zephyr Arch Kconfig descriptions.
osource "/home/vvdn/zephyrproject/zephyr/arch/rx/Kconfig"
osource "/home/vvdn/zephyrproject/zephyr/arch/x86/Kconfig"
osource "/home/vvdn/zephyrproject/zephyr/arch/xtensa/Kconfig"
osource "/home/vvdn/zephyrproject/zephyr/arch/sparc/Kconfig"
osource "/home/vvdn/zephyrproject/zephyr/arch/riscv/Kconfig"
osource "/home/vvdn/zephyrproject/zephyr/arch/posix/Kconfig"
osource "/home/vvdn/zephyrproject/zephyr/arch/openrisc/Kconfig"
osource "/home/vvdn/zephyrproject/zephyr/arch/mips/Kconfig"
osource "/home/vvdn/zephyrproject/zephyr/arch/arm64/Kconfig"
osource "/home/vvdn/zephyrproject/zephyr/arch/arm/Kconfig"
osource "/home/vvdn/zephyrproject/zephyr/arch/arc/Kconfig"
```

## ZEPHYR/GPIO/gpio_blink/build/Kconfig/boards/Kconfig
```kconfig
# Load Zephyr board Kconfig descriptions.
osource "/home/vvdn/zephyrproject/zephyr/boards/st/nucleo_f446ze/Kconfig"
```

## ZEPHYR/TIMER/lifecycle/build/Kconfig/boards/Kconfig.defconfig
```kconfig
# Load Zephyr board defconfig descriptions.
osource "/home/vvdn/zephyrproject/zephyr/boards/st/nucleo_f446ze/Kconfig.defconfig"
```

## ZEPHYR/TIMER/lifecycle/build/Kconfig/boards/Kconfig.nucleo_f446ze
```kconfig
# Load board Kconfig descriptions.
osource "/home/vvdn/zephyrproject/zephyr/boards/st/nucleo_f446ze/Kconfig.nucleo_f446ze"
```
